## package/keyinfuser/Config.in
```kconfig
menu "Keyinfuser packages"
	source "package/keyinfuser/pwm_mk/Config.in"
	source "package/keyinfuser/gpio_debouncing_mk/Config.in
endmenu
```

## package/keyinfuser/gpio_debouncing_mk/Config.in
```kconfig
config BR2_PACKAGE_GPIO_DEBOUNCING_MK
	bool "gpio_debouncing_mk"
	depends on BR2_arm # only relevant for TI am335x
	depends on BR2_BINFMT_ELF # assumes the compiler builds ELF file
	help
```

## package/keyinfuser/pwm_mk/Config.in
```kconfig
config BR2_PACKAGE_PWM_MK
	bool "pwm_mk"
	depends on BR2_arm # only relevant for TI am335x
	depends on BR2_BINFMT_ELF # assumes the compiler builds ELF file
	help
```
